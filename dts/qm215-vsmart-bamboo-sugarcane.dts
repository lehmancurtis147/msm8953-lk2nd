// SPDX-License-Identifier: GPL-2.0-only

/dts-v1/;

/include/ "msm8952.dtsi"

/ {
	// This is used by the bootloader to find the correct DTB 
	qcom,msm-id = <0x182 0x0>;
	qcom,board-id = <0xb 0x5>;

	model = "QRD";
	compatible = "qcom,qm215", "lk2nd,device";

	// Bootloader won't continue if it can't delete some nodes from below
	soc {
		#address-cells = <1>;
		#size-cells = <1>;
		ranges = <0x0 0x0 0x0 0xffffffff>;

	};
};
