// SPDX-License-Identifier: GPL-2.0-only
// Copyright (C) 2020 - Dreemurrs Embedded Labs

/dts-v1/;

/include/ "msm8952.dtsi"

/ {
	// This is used by the bootloader to find the correct DTB 
	qcom,msm-id = <0x12f 0x0 0x134 0x0 0x135 0x0>;
	qcom,board-id = <0x8 0x0>;

	model = "Qualcomm Technologies, Inc. JEICE";
	compatible = "qcom,msm8917-mtp", "qcom,msm8917", "qcom,mtp", "lk2nd,device";

	// Bootloader won't continue if it can't delete some nodes from below
	soc {
		#address-cells = <1>;
		#size-cells = <1>;
		ranges = <0x0 0x0 0x0 0xffffffff>;

	};
};
