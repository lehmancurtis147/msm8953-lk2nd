// SPDX-License-Identifier: GPL-2.0-only
// Copyright (C) 2020 - Dreemurrs Embedded Labs

/dts-v1/;

/include/ "msm8952.dtsi"

/ {
	// This is used by the bootloader to find the correct DTB 
	qcom,msm-id = <0x126 0x0>;
	qcom,board-id = <0x8 0x10000>;

	model = "Qualcomm Technologies, Inc. MSM8937 BASE";
	compatible = "qcom,msm8937-base", "qcom,msm8937", "qcom,base", "lk2nd,device";

	// Bootloader won't continue if it can't delete some nodes from below
	soc {
		#address-cells = <1>;
		#size-cells = <1>;
		ranges = <0x0 0x0 0x0 0xffffffff>;

	};
};
