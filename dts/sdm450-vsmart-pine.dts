// SPDX-License-Identifier: GPL-2.0-only

/dts-v1/;

/include/ "msm8953.dtsi"

/ {
	// This is used by the bootloader to find the correct DTB 
	qcom,msm-id = <0x152 0x0>;
	qcom,board-id = <0xb 0x1>;

	model = "Qualcomm Technologies, Inc. SDM450 + PMI632 SOC";
	compatible = "qcom,sdm450", "lk2nd,device";

	// Bootloader won't continue if it can't delete some nodes from below
	soc {
		#address-cells = <1>;
		#size-cells = <1>;
		ranges = <0x0 0x0 0x0 0xffffffff>;
	};
};
